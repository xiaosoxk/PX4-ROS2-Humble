## firmware/px4_modules/ai_gateway/Kconfig
```kconfig
menuconfig MODULES_AI_GATEWAY
	bool "ai_gateway"
	default n
	---help---
	AI companion gateway: sanitizes offboard setpoints from Jetson Orin NX.
	Enforces stream-timeout / tilt / geofence / battery revocation rules.
```
